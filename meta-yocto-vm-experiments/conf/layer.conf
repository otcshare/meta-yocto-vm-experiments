## meta-yocto-vm-experiments/conf/layer.conf
```bitbake
# We have a conf and classes directory, add to BBPATH
BBPATH .= ":${LAYERDIR}"

# We have recipes-* directories, add to BBFILES
BBFILES += "${LAYERDIR}/recipes-*/*/*.bb \
	${LAYERDIR}/recipes-*/*/*.bbappend"

BBFILE_COLLECTIONS += "yocto-vm-experiments"
BBFILE_PATTERN_yocto-vm-experiments = "^${LAYERDIR}/"
BBFILE_PRIORITY_yocto-vm-experiments = "6"
```
